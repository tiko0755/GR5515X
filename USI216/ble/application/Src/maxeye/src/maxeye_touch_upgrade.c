#include "gr55xx.h"
#include "app_log.h"
#include "app_error.h"
#include "app_i2c.h"

#include "hal_flash.h"

#include "maxeye_wdt.h"
#include "maxeye_i2c.h"
#include "maxeye_touch.h"
#include "maxeye_touch_upgrade.h"


/*
 * DEFINES
 *****************************************************************************************
 */
#ifdef  UPGRADE_LOG_EN
#define LOG(format,...)  printf(format,##__VA_ARGS__) 
#else
#define LOG(format,...)  
#endif


#define TOUCH_7BIT_ADDR                            (0x38)

#define TOUCH_DELAY(X)                             delay_ms(X)

#define SEND_PACKAGE_SIZE                          128
#define FIRMWARE_SIZE                              0x7EA0//touch固件大小不能随意更改，需与固件大小一致



#define TOUCH_STATUS_OK                            0
#define ENTER_TOUCH_ROMBOOT_MODE_FAIL              1
#define READ_TOUCH_ROMBOOT_ID_FAIL                 2
#define WRITE_TOUCH_ROMBOOT_FAIL                   3
#define GET_TOUCH_ECC_FAIL                         4
#define TOUCH_ECC_VERIFY_FAIL                      5
#define TOUCH_ROMBOOT_RUN_FAIL                     6
#define ENTER_TOUCH_UPGRADE_MODE_FAIL              7
#define READ_TOUCH_UPGRADE_ID_FAIL                 8
#define ERASE_TOUCH_FLASH_FAIL                     9
#define WRITE_TOUCH_FIRMWARE_FAIL                  10
#define GET_TOUCH_FIRMWARE_ECC_FAIL                11
#define TOUCH_FIRMWARE_ECC_VERIFY_FAIL             12
#define TOUCH_UPGRADE_RESET_FAIL                   13


typedef struct
{
    uint8_t   pkHead;   
    uint8_t   pkAddH;
    uint8_t   pkAddM;
    uint8_t   pkAddL; 
	uint8_t   pkLenH;
	uint8_t   pkLenL; 
    uint8_t   pkbuff[SEND_PACKAGE_SIZE];  

} touch_package_t;




/*
 * LOCAL VARIABLE DEFINITIONS
 *****************************************************************************************
 */
const uint8_t  PramBoot[]={ \
0x2, 0x7, 0x70,0xca,0x39,0x12,0xd, 0x37,0xda,0x39,0x32,0x2, 0x0, 0x3, 0x6d,0x22,
0x80,0x13,0x75,0xb5,0x0, 0xa9,0x36,0xb3,0xfc,0xa9,0xc6,0xb3,0xe5,0xb5,0x7a,0xb, 
0xb0,0xb, 0x14,0xb, 0x24,0xbd,0x32,0x38,0xe9,0x22,0x22,0x2, 0xb, 0x36,0xa9,0xc2,
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0xd, 0x37,0x0, 0x4, 0x3, 0x16,0x0, 0x0, 0x9c,0x0, 0x0, 0x0, 0xff,0xff,0xff,0xff,
};  




static uint8_t retryCnt;

/*
 * GLOBAL VARIABLE DEFINITIONS
 *****************************************************************************************
 */




/*
 * LOCAL FUNCTION DEFINITIONS
 *****************************************************************************************
 */

/**
 *****************************************************************************************
 * @brief 
 *
 * @param[in]
 *
 * @return 
 *****************************************************************************************
 */
uint16_t Touch_Send_nByte(uint8_t *regData,uint8_t bLen)
{
	uint16_t ret;

	for(uint8_t i = 0; i < 3; i++) 
	{
		ret = maxeye_i2c0_transmit(TOUCH_7BIT_ADDR,regData,bLen);
		if (ret==APP_DRV_SUCCESS) 
		{
			break;
		}
	}
	return ret;
}



/**
 *****************************************************************************************
 * @brief 
 *
 * @param[in]
 *
 * @return 
 *****************************************************************************************
 */
uint16_t Touch_Recv_nByte(uint8_t reg_addr, uint8_t * regData,uint8_t bLen) 
{
	uint16_t ret;

	for(uint8_t i = 0; i < 3; i++) 
	{
		ret = maxeye_i2c0_read(TOUCH_7BIT_ADDR,reg_addr,I2C_MEMADD_SIZE_8BIT,regData,bLen);
		if (ret==APP_DRV_SUCCESS) 
		{
			break;
		}
	}
	return ret;
}


/**
 *****************************************************************************************
 * @brief 
 *
 * @param[in]
 *
 * @return 
 *****************************************************************************************
 */
uint8_t fts_ecc_xor8_host(const uint8_t *pData, uint16_t len)
{
	uint8_t ecc = 0;

	for (uint16_t i = 0; i < len; i++) 
	{
		ecc ^= pData[i];
	}

	return ecc;
}

/**
 *****************************************************************************************
 * @brief 
 *
 * @param[in]
 *
 * @return 
 *****************************************************************************************
 */
void touch_soft_reset(void)
{
	uint8_t databuff[2]={0xFC,0xAA};

	Touch_Send_nByte(databuff,2);
	TOUCH_DELAY(10);
	databuff[1]=0x55;
	Touch_Send_nByte(databuff,2);
}

/**
 *****************************************************************************************
 * @brief 
 *
 * @param[in]
 *
 * @return 
 *****************************************************************************************
 */
uint16_t enter_romboot_mode(void)
{
	uint8_t databuff[2]={0x55,0xAA};

	return Touch_Send_nByte(databuff,2);
}

/**
 *****************************************************************************************
 * @brief 
 *
 * @param[in]
 *
 * @return 
 *****************************************************************************************
 */
uint16_t romboot_mode_verify(uint8_t bStatus)
{
	uint8_t databuff[2]={0x90,0};


	retryCnt=10;
	while(retryCnt)
	{
		Touch_Recv_nByte(0x90,databuff,2);
		if(databuff[0]==0x62 && databuff[1]==bStatus)
		{
     		return TOUCH_STATUS_OK;
		}
		retryCnt--;
		LOG("rbt vfy:%d\r\n",retryCnt);
		TOUCH_DELAY(20);
	}
	return READ_TOUCH_ROMBOOT_ID_FAIL;
}


/**
 *****************************************************************************************
 * @brief 
 *
 * @param[in]
 *
 * @return 
 *****************************************************************************************
 */
uint16_t write_touch_romboot(void)
{
	uint8_t i;
	uint16_t startAddr=0; 
	uint16_t rombootSize=0; 
	touch_package_t touchPackage;

	rombootSize=sizeof(PramBoot);
	LOG("romboot size:%d\r\n",rombootSize);

	touchPackage.pkHead=0xAE;
	touchPackage.pkAddH=0;
	for(i=0;i<(rombootSize/SEND_PACKAGE_SIZE);i++)
	{
		startAddr=i*SEND_PACKAGE_SIZE;
		touchPackage.pkAddM=startAddr>>8;
		touchPackage.pkAddL=startAddr;
		touchPackage.pkLenH=SEND_PACKAGE_SIZE>>8;
		touchPackage.pkLenL=SEND_PACKAGE_SIZE;
		memcpy(touchPackage.pkbuff,&PramBoot[startAddr],SEND_PACKAGE_SIZE);
		if(Touch_Send_nByte(&touchPackage.pkHead,SEND_PACKAGE_SIZE+6)!=TOUCH_STATUS_OK)
		{
			return WRITE_TOUCH_ROMBOOT_FAIL;
		}
		// delay_us(100);
	}

	if(rombootSize%SEND_PACKAGE_SIZE)
	{
		startAddr=i*SEND_PACKAGE_SIZE;
		touchPackage.pkAddM=startAddr>>8;
		touchPackage.pkAddL=startAddr;
		touchPackage.pkLenH=(rombootSize%SEND_PACKAGE_SIZE)>>8;
		touchPackage.pkLenL=(rombootSize%SEND_PACKAGE_SIZE);
		memcpy(touchPackage.pkbuff,&PramBoot[startAddr],(rombootSize%SEND_PACKAGE_SIZE));
		if(Touch_Send_nByte(&touchPackage.pkHead,((rombootSize%SEND_PACKAGE_SIZE)+6))!=TOUCH_STATUS_OK)
		{
			return WRITE_TOUCH_ROMBOOT_FAIL;
		}
	}

	return TOUCH_STATUS_OK;
}

/**
 *****************************************************************************************
 * @brief 
 *
 * @param[in]
 *
 * @return 
 *****************************************************************************************
 */
uint16_t touch_romboot_verify(uint8_t *bEcc)
{
	retryCnt=5;

   	while(retryCnt)
	{ 
		if(Touch_Recv_nByte(0xCC,bEcc,1)==TOUCH_STATUS_OK)		
		{
			return TOUCH_STATUS_OK;
		}
		retryCnt--;
		LOG("pk vfy:%d\r\n",retryCnt);
		TOUCH_DELAY(20);
	}
	return GET_TOUCH_ECC_FAIL;
}


/**
 *****************************************************************************************
 * @brief 
 *
 * @param[in]
 *
 * @return 
 *****************************************************************************************
 */
uint16_t romboot_run(void)
{
	uint8_t bCmd=0x08;

	if(Touch_Send_nByte(&bCmd,1)!=TOUCH_STATUS_OK)
	{
		return TOUCH_ROMBOOT_RUN_FAIL;
	}
	return TOUCH_STATUS_OK;
}

/**
 *****************************************************************************************
 * @brief 
 *
 * @param[in]
 *
 * @return 
 *****************************************************************************************
 */
uint16_t upgrade_erase_falsh(void)
{
	uint8_t databuff[2]={0x09,0x0B};

	if(Touch_Send_nByte(databuff,2)!=TOUCH_STATUS_OK) //erase type : erase app area
	{
		return ERASE_TOUCH_FLASH_FAIL;
	}

	databuff[0]=0x61; //erase cmd

	if(Touch_Send_nByte(databuff,1)!=TOUCH_STATUS_OK)
	{
		return ERASE_TOUCH_FLASH_FAIL;
	}

	retryCnt=5;

	while(retryCnt)
	{
		TOUCH_DELAY(100);
		Touch_Recv_nByte(0x6A,databuff,2);
		if(databuff[0]==0xF0 && databuff[1]==0xAA) //erase cmp
		{
			LOG("erase ok\r\n");
     		return TOUCH_STATUS_OK;
		}
		retryCnt--;
		LOG("erase:%d\r\n",retryCnt);
	}
	return ERASE_TOUCH_FLASH_FAIL;
}


/**
 *****************************************************************************************
 * @brief 
 *
 * @param[in]
 *
 * @return 
 *****************************************************************************************
 */
uint16_t upgrade_package_verify(uint16_t writeStatus)
{
	uint8_t  databuff[2];

	retryCnt=5;
	TOUCH_DELAY(2);

	while(retryCnt)
	{
		Touch_Recv_nByte(0x6A,databuff,2);
		if(databuff[0]==(uint8_t)(writeStatus>>8) && databuff[1]==(uint8_t)(writeStatus))
		{
			return TOUCH_STATUS_OK;
		}
		retryCnt--;
		LOG("up vfy:%d,%d,%x,%x\r\n",retryCnt,writeStatus,databuff[0],databuff[1]);
		TOUCH_DELAY(10);
	}
	return WRITE_TOUCH_FIRMWARE_FAIL;
}



/**
 *****************************************************************************************
 * @brief 
 *
 * @param[in]
 *
 * @return 
 *****************************************************************************************
 */

uint16_t upgrade_write_touch_firmware(uint32_t firmwareStartAddr)
{
	uint16_t i;

	uint16_t startAddr=0; 
	uint16_t writeStatus=0; 

	touch_package_t touchPackage;

	touchPackage.pkHead=0xBF;
	touchPackage.pkAddH=0;
	// APP_LOG_INFO("touch fw addr:%8x",firmwareStartAddr);
	for(i=0;i<=(FIRMWARE_SIZE/SEND_PACKAGE_SIZE);i++)
	{
		startAddr=i*SEND_PACKAGE_SIZE;
		touchPackage.pkAddM=startAddr>>8;
		touchPackage.pkAddL=startAddr;
		touchPackage.pkLenH=SEND_PACKAGE_SIZE>>8;
		touchPackage.pkLenL=SEND_PACKAGE_SIZE;
		hal_flash_read(firmwareStartAddr+startAddr, touchPackage.pkbuff, SEND_PACKAGE_SIZE);
		#if 0
		for(uint8_t j=0;j<SEND_PACKAGE_SIZE;j++)
		{
			printf("%02x ",touchPackage.pkbuff[j]);
			if((i%10)==0)
			{
				maxeye_wdt_refresh();
			}
		}
		#endif
		if(Touch_Send_nByte(&touchPackage.pkHead,SEND_PACKAGE_SIZE+6)!=TOUCH_STATUS_OK)
		{
			return WRITE_TOUCH_FIRMWARE_FAIL;
		}

		writeStatus=0x1000+startAddr/SEND_PACKAGE_SIZE;

		if(upgrade_package_verify(writeStatus)!=TOUCH_STATUS_OK)
		{
			return WRITE_TOUCH_FIRMWARE_FAIL;
		}
	}
	LOG("verify ok:%d\r\n",i);
	return TOUCH_STATUS_OK;
}

/**
 *****************************************************************************************
 * @brief 
 *
 * @param[in]
 *
 * @return 
 *****************************************************************************************
 */
void get_touch_firmware(uint8_t offset,uint32_t firmwareStartAddr)
{
	uint16_t startAddr=0; 
	touch_package_t touchPackage;

	touchPackage.pkHead=0xBF;
	touchPackage.pkAddH=0;
	startAddr=offset*SEND_PACKAGE_SIZE;
	touchPackage.pkAddM=startAddr>>8;
	touchPackage.pkAddL=startAddr;
	touchPackage.pkLenH=SEND_PACKAGE_SIZE>>8;
	touchPackage.pkLenL=SEND_PACKAGE_SIZE;
	hal_flash_read(firmwareStartAddr+startAddr, touchPackage.pkbuff, SEND_PACKAGE_SIZE);
	LOG("package:");
	for(uint8_t i=0;i<SEND_PACKAGE_SIZE;i++)
	{
		LOG(" %x,",touchPackage.pkbuff[i]);
	}
	LOG("\r\n");
}

/**
 *****************************************************************************************
 * @brief 
 *
 * @param[in]
 *
 * @return 
 *****************************************************************************************
 */
uint8_t fw_ecc_xor8_host(uint32_t firmwareStartAddr)
{
	uint8_t ecc = 0;
	uint8_t databuff[SEND_PACKAGE_SIZE];
	uint16_t startAddr;

	for(uint16_t i=0;i<=(FIRMWARE_SIZE/SEND_PACKAGE_SIZE);i++)
	{
		startAddr=i*SEND_PACKAGE_SIZE;
		hal_flash_read(firmwareStartAddr+startAddr,databuff, SEND_PACKAGE_SIZE);
		for (uint8_t j = 0; j < SEND_PACKAGE_SIZE; j++) 
		{
			ecc ^= databuff[j];
		}
	}
	return ecc;
}




/**
 *****************************************************************************************
 * @brief 
 *
 * @param[in]
 *
 * @return 
 *****************************************************************************************
 */
uint16_t upgrade_get_firmware_ecc(uint8_t *bEcc)
{
	uint8_t  databuff[6];

	databuff[0]=0x64;    //clear ecc

	if(	Touch_Send_nByte(databuff,1)!=TOUCH_STATUS_OK)
	{
		return GET_TOUCH_FIRMWARE_ECC_FAIL;
	}
    

	memset(databuff,0,6);

	databuff[0]=0x65;    //ecc cfg
	databuff[4]=FIRMWARE_SIZE>>8;
	databuff[5]=(uint8_t)FIRMWARE_SIZE;
	if(	Touch_Send_nByte(databuff,6)!=TOUCH_STATUS_OK)
	{
		return GET_TOUCH_FIRMWARE_ECC_FAIL;
	}

	retryCnt=5;
	TOUCH_DELAY(200);
	while(retryCnt)
	{
		Touch_Recv_nByte(0x6A,databuff,2);
		if(databuff[0]==0xF0 && databuff[1]==0x55)
		{
			break;
		}
		retryCnt--;
		LOG("get ecc:%d\r\n",retryCnt);
		TOUCH_DELAY(50);
	}

	retryCnt=5;
   	while(retryCnt)
	{ 
		if(Touch_Recv_nByte(0x66,bEcc,1)==TOUCH_STATUS_OK)
		{
			return TOUCH_STATUS_OK;
		}
		retryCnt--;
		LOG("fw vfy:%d\r\n",retryCnt);
		TOUCH_DELAY(20);
	}
	return GET_TOUCH_FIRMWARE_ECC_FAIL;
}

/**
 *****************************************************************************************
 * @brief 
 *
 * @param[in]
 *
 * @return 
 *****************************************************************************************
 */
uint16_t upgrade_reset(void)
{
	uint8_t  data;

	data=0x07;    

	if(	Touch_Send_nByte(&data,1)!=TOUCH_STATUS_OK)
	{
		return TOUCH_UPGRADE_RESET_FAIL;
	}
	return TOUCH_STATUS_OK;
}





/**
 *****************************************************************************************
 * @brief 
 *
 * @param[in]
 *
 * @return 
 *****************************************************************************************
 */
uint16_t touch_upgrade_handle(uint32_t firmwareStartAddr) //touch 升级i2c频率不支持1M
{
	uint8_t bEcc;
	uint8_t upgradeRetryCnt=4;


TOUCH_ROMNBOOT_MODE:

	maxeye_wdt_refresh();

	if(upgradeRetryCnt/2!=0)
	{
		touch_sensor_reset();
	}
	else
	{
		touch_soft_reset();
	}

	TOUCH_DELAY(15);

	if(enter_romboot_mode()!=TOUCH_STATUS_OK)
	{
		return ENTER_TOUCH_ROMBOOT_MODE_FAIL;
	}
	TOUCH_DELAY(8);
	
	if(romboot_mode_verify(0x16)!=TOUCH_STATUS_OK)
	{
		if(upgradeRetryCnt)
		{
			upgradeRetryCnt--;
			goto TOUCH_ROMNBOOT_MODE;
		}
		return READ_TOUCH_ROMBOOT_ID_FAIL;
	}

	if(write_touch_romboot()!=TOUCH_STATUS_OK)
	{
		return WRITE_TOUCH_ROMBOOT_FAIL;
	}

	if(touch_romboot_verify(&bEcc)!=TOUCH_STATUS_OK)
	{
		return GET_TOUCH_ECC_FAIL;
	}
	
	if(fts_ecc_xor8_host(PramBoot,sizeof(PramBoot))!=bEcc)
	{
		return TOUCH_ECC_VERIFY_FAIL;
	}

	if(romboot_run()!=TOUCH_STATUS_OK)
	{
		return TOUCH_ROMBOOT_RUN_FAIL;
	}

	TOUCH_DELAY(10);

	if(enter_romboot_mode()!=APP_DRV_SUCCESS)
	{
		return ENTER_TOUCH_UPGRADE_MODE_FAIL;
	}

	if(romboot_mode_verify(0x1A)!=TOUCH_STATUS_OK)
	{
		return READ_TOUCH_UPGRADE_ID_FAIL;
	}
	
    if(upgrade_erase_falsh()!=TOUCH_STATUS_OK)
	{
		return ERASE_TOUCH_FLASH_FAIL;
	}

	maxeye_wdt_refresh();
	
	if(upgrade_write_touch_firmware(firmwareStartAddr)!=TOUCH_STATUS_OK)
	{
		return WRITE_TOUCH_FIRMWARE_FAIL;
	}

	if(upgrade_get_firmware_ecc(&bEcc)!=TOUCH_STATUS_OK)
	{
		return GET_TOUCH_FIRMWARE_ECC_FAIL;
	}

	if(fw_ecc_xor8_host(firmwareStartAddr)!=bEcc)
	{
		return TOUCH_FIRMWARE_ECC_VERIFY_FAIL;	   
	}

	if(upgrade_reset()!=TOUCH_STATUS_OK)
	{
		return TOUCH_UPGRADE_RESET_FAIL;
	}
	
	return TOUCH_STATUS_OK;
}










