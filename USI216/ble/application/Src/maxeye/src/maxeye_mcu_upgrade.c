#include "gr55xx.h"
#include "app_log.h"
#include "app_error.h"
#include "app_i2c.h"
#include "app_timer.h"


#include "bsp.h"

#include "hal_flash.h"

#include "maxeye_wdt.h"
#include "maxeye_mcu_stylus.h"
#include "maxeye_mcu_upgrade.h"


/*
 * DEFINES
 *****************************************************************************************
 */
#ifdef  UPGRADE_LOG_EN
#define LOG(format,...)  printf(format,##__VA_ARGS__) 
#else
#define LOG(format,...)  
#endif


#define MCU_DELAY_MS(X)                         delay_ms(X)

#define MCU_STATUS_OK                           0
#define ENTER_MCU_RAMCODE_MODE_FAIL             1
#define WRITE_MCU_RAMCODE_FAIL                  2
#define MCU_RAMCODE_RUN_FAIL                    3
#define MCU_ERASE_FLASH_FAIL                    4
#define MCU_BAUDRATE_SET_FAIL                   5
#define MCU_TM_ERASE_FLASH_FAIL                 6
#define MCU_TP_ERASE_FLASH_FAIL                 7
#define MCU_FLASH_CHECK_BLANK_FAIL              8
#define MCU_WRITE_FIRMWARE_FAIL                 9
#define MCU_GET_FIRMWARE_ECC_FAIL               10
#define MCU_FIRMWARE_ECC_VERIFY_FAIL            11
#define MCU_FIRMWARE_ENCRYPTION_FAIL            12
#define MCU_UPGRADE_RESET_FAIL                  13



#define MCU_ACK_SUCEESS                         1
#define MCU_ACK_FAIL                            2



#define MCU_UPGRADE_BAUDRATE                    691200
#define RAMCODE_START_ADDR                      0x20000000
#define SEND_PACKAGE_SIZE                       128
#define FIRMWARE_SIZE                           0x6000//0x8000

#define MCU_FLASH_SECTOR_SIZE                   512


enum mcu_ramcode_pk_t
{
    MCU_RAMCODE_PK_CMD,
    MCU_RAMCODE_PK_ADDR_1,
    MCU_RAMCODE_PK_ADDR_2,
    MCU_RAMCODE_PK_ADDR_3,
    MCU_RAMCODE_PK_ADDR_4,
    MCU_RAMCODE_PK_LEN_1,
    MCU_RAMCODE_PK_LEN_2,
    MCU_RAMCODE_PK_LEN_3,
    MCU_RAMCODE_PK_LEN_4,
    MCU_RAMCODE_PK_SUM_1,
};

/*
 * LOCAL VARIABLE DEFINITIONS
 *****************************************************************************************
 */
const uint8_t  RamCode[] =
{
    0xB8,0x0A,0x00,0x20,0x09,0x00,0x00,0x20,0x72,0xB6,0x03,0x48,0x01,0x68,0x81,0xF3,0x08,0x88,0x02,0x48,0x00,0x47,0x00,0x00,0x00,0x00,0x00,0x20,0x95,0x07,0x00,0x20,
    0xC0,0x68,0x01,0x68,0x6E,0x48,0x01,0x62,0x6E,0x4A,0x89,0x18,0x6E,0x4A,0x91,0x42,0x01,0xD3,0x06,0x21,0x81,0x71,0x70,0x47,0x80,0xB5,0x00,0xF0,0xE7,0xF8,0x6B,0x48,
    0x01,0x68,0x03,0x22,0x0A,0x43,0x02,0x60,0x00,0x21,0x09,0x60,0x01,0x68,0xCA,0x06,0xD2,0x0F,0xFB,0xD1,0x01,0xBD,0x10,0xB5,0x04,0x00,0x60,0x68,0x80,0x21,0x09,0x02,
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    0x00,0x00,0x00,0x00,
};

/*
 * GLOBAL VARIABLE DEFINITIONS
 *****************************************************************************************
 */




/*
 * LOCAL FUNCTION DEFINITIONS
 *****************************************************************************************
 */
static uint16_t firmwareCheckSum;


/**
 *****************************************************************************************
 * @brief 
 *
 * @param[in]
 *
 * @return 
 *****************************************************************************************
 */
uint16_t get_mcu_sum_check(uint8_t *pData,uint16_t size)
{
    uint16_t sumcheck=0;

    for(uint16_t i=0;i<size;i++)
    {
        sumcheck+=pData[i];
    }

    return sumcheck;
}




/**
 *****************************************************************************************
 * @brief 
 *
 * @param[in]
 *
 * @return 
 *****************************************************************************************
 */
uint16_t mcu_enter_romboot(void)
{
    uint8_t bData;
    uint8_t bRetry=5;

    mcu_reset_control();

    MCU_DELAY_MS(2);

    while(bRetry--)
    {
        bData=0x18;
        app_uart_transmit_sync(APP_UART_ID_1,&bData,1,100);
        app_uart_receive_sync(APP_UART_ID_1,&bData,1,2);
        if(bData==0x11)
        {
            return MCU_STATUS_OK;
        }
    }
    return ENTER_MCU_RAMCODE_MODE_FAIL;
}









/**
 *****************************************************************************************
 * @brief 
 *
 * @param[in]
 *
 * @return 
 *****************************************************************************************
 */
uint16_t write_mcu_ramcode(void)
{
    uint8_t i;
    uint8_t mcusum=0;
    uint8_t mcupk[SEND_PACKAGE_SIZE+1];
    uint16_t pksize;
    uint16_t startAddr=0; 
    uint16_t ramcodeSize=0; 

    ramcodeSize=sizeof(RamCode);
    pksize=ramcodeSize%SEND_PACKAGE_SIZE;
    LOG("ramcode size:%d,%d\r\n",ramcodeSize,pksize);

    mcupk[MCU_RAMCODE_PK_CMD]=0;
    mcupk[MCU_RAMCODE_PK_ADDR_1]=0;
    mcupk[MCU_RAMCODE_PK_ADDR_2]=0;
    mcupk[MCU_RAMCODE_PK_ADDR_3]=0;
    mcupk[MCU_RAMCODE_PK_ADDR_4]=0x20;
    mcupk[MCU_RAMCODE_PK_LEN_1]=ramcodeSize;
    mcupk[MCU_RAMCODE_PK_LEN_2]=ramcodeSize>>8;
    mcupk[MCU_RAMCODE_PK_LEN_3]=0;
    mcupk[MCU_RAMCODE_PK_LEN_4]=0;
    mcupk[MCU_RAMCODE_PK_SUM_1]=get_mcu_sum_check(mcupk,9);
    app_uart_transmit_sync(APP_UART_ID_1,mcupk,10,100);
    mcupk[0]=0;
    app_uart_receive_sync(APP_UART_ID_1,mcupk,1,100);
    if(mcupk[0]!=MCU_ACK_SUCEESS)
    {
        LOG("mcu Ack:%x\r\n",mcupk[0]);
        return WRITE_MCU_RAMCODE_FAIL;     
    }

    for(i=0;i<(ramcodeSize/SEND_PACKAGE_SIZE);i++)
    {
        startAddr=i*SEND_PACKAGE_SIZE;
        memcpy(mcupk,&RamCode[startAddr],SEND_PACKAGE_SIZE);
        mcusum+=get_mcu_sum_check(mcupk,SEND_PACKAGE_SIZE);
        app_uart_transmit_sync(APP_UART_ID_1,mcupk,SEND_PACKAGE_SIZE,100);
    }


    if(pksize)
    {
        startAddr=i*SEND_PACKAGE_SIZE;
        memcpy(mcupk,&RamCode[startAddr],pksize);
        mcupk[pksize]=mcusum+get_mcu_sum_check(mcupk,pksize);
        LOG("ramcode sum:%d\r\n",mcupk[pksize]);
        app_uart_transmit_sync(APP_UART_ID_1,mcupk,pksize+1,100);
        mcupk[0]=0;
        app_uart_receive_sync(APP_UART_ID_1,mcupk,1,1000);
        if(mcupk[0]!=MCU_ACK_SUCEESS)
        {
            LOG("mcu Ack:%x\r\n",mcupk[0]);
            return WRITE_MCU_RAMCODE_FAIL;     
        }
    }
    return MCU_STATUS_OK;
}



/**
 *****************************************************************************************
 * @brief 
 *
 * @param[in]
 *
 * @return 
 *****************************************************************************************
 */
uint16_t mcu_ramcode_run(void)
{
    uint8_t mcupk[11]={0};

    mcupk[0]=0xC0;
    mcupk[9]=0xC0;

    app_uart_transmit_sync(APP_UART_ID_1,mcupk,10,100);
    if(app_uart_receive_sync(APP_UART_ID_1,mcupk,11,100)!=APP_DRV_SUCCESS)
    {
        return MCU_RAMCODE_RUN_FAIL;
    }

    MCU_DELAY_MS(5);

    return MCU_STATUS_OK;
}




/**
 *****************************************************************************************
 * @brief 
 *
 * @param[in]
 *
 * @return 
 *****************************************************************************************
 */
uint16_t mcu_uart_baudrate_set(uint32_t wBaudrate)
{
    uint8_t mcupk[13]={0x49,0x01,0,0,0,0,0x04,0,0,0,0,0,0};

    mcupk[8] =wBaudrate;
    mcupk[9] =wBaudrate>>8;
    mcupk[10]=wBaudrate>>16;
    mcupk[11]=wBaudrate>>24;
    mcupk[12]=get_mcu_sum_check(mcupk,12);

    app_uart_transmit_sync(APP_UART_ID_1,mcupk,13,100);
    mcupk[0]=0;
    app_uart_receive_sync(APP_UART_ID_1,mcupk,9,100);
    if(mcupk[0]!=0x49 || mcupk[8]!=0x49)
    {
        LOG("mcu Ack:%x\r\n",mcupk[0]);
        return MCU_BAUDRATE_SET_FAIL;   
    }
    ll_uart_set_baud_rate(UART1,CLK_64M,wBaudrate);
    // MCU_DELAY_MS(1);
    return MCU_STATUS_OK;
}


/**
 *****************************************************************************************
 * @brief 
 *
 * @param[in]
 *
 * @return 
 *****************************************************************************************
 */
uint16_t mcu_flash_tm_erase(uint32_t tmAddr)//片擦除
{
    uint8_t checksum;
    uint8_t mcupk[9]={0x49,0x02,0,0,0,0,0,0,0};

    mcupk[2]=tmAddr;
    mcupk[3]=tmAddr>>8;
    mcupk[4]=tmAddr>>16;
    mcupk[5]=tmAddr>>24;

    mcupk[8]=get_mcu_sum_check(mcupk,8);

    app_uart_transmit_sync(APP_UART_ID_1,mcupk,9,100);
    mcupk[0]=0;
    app_uart_receive_sync(APP_UART_ID_1,mcupk,9,100);
    checksum=get_mcu_sum_check(mcupk,8);
    if(mcupk[0]!=0x49 || mcupk[8]!=checksum)
    {
        LOG("mcu Ack:%x\r\n",mcupk[0]);
        return MCU_TM_ERASE_FLASH_FAIL;
    }
    MCU_DELAY_MS(50);
    return MCU_STATUS_OK;
}



/**
 *****************************************************************************************
 * @brief 
 *
 * @param[in]
 *
 * @return 
 *****************************************************************************************
 */
uint16_t mcu_flash_tp_erase(uint32_t tpAddr)//页擦除
{
    uint8_t checksum;
    uint8_t mcupk[9]={0x49,0x03,0,0,0,0,0,0,0};

    mcupk[2]=tpAddr;
    mcupk[3]=tpAddr>>8;
    mcupk[4]=tpAddr>>16;
    mcupk[5]=tpAddr>>24;

    mcupk[8]=get_mcu_sum_check(mcupk,8);

    app_uart_transmit_sync(APP_UART_ID_1,mcupk,9,100);
    mcupk[0]=0;
    app_uart_receive_sync(APP_UART_ID_1,mcupk,9,100);
    checksum=get_mcu_sum_check(mcupk,8);
    if(mcupk[0]!=0x49 || mcupk[8]!=checksum)
    {
        LOG("mcu Ack:%x\r\n",mcupk[0]);
        return MCU_TP_ERASE_FLASH_FAIL;     
    }
    return MCU_STATUS_OK;
}

/**
 *****************************************************************************************
 * @brief 
 *
 * @param[in]
 *
 * @return 
 *****************************************************************************************
 */
uint16_t mcu_flash_erase(uint32_t size)
{
    uint16_t sector_count = (size / MCU_FLASH_SECTOR_SIZE) + !!(size % MCU_FLASH_SECTOR_SIZE);

    for (uint16_t i = 0; i < sector_count; i++)
    {
        if (MCU_STATUS_OK != mcu_flash_tp_erase(i * MCU_FLASH_SECTOR_SIZE))
        {
            return MCU_ERASE_FLASH_FAIL;
        }
    }

    return MCU_STATUS_OK;
}

/**
 *****************************************************************************************
 * @brief 
 *
 * @param[in]
 *
 * @return 
 *****************************************************************************************
 */
uint16_t mcu_flash_check_blank(uint32_t wAddr,uint32_t wSize)//空白检查
{
    uint8_t checksum;
    uint8_t mcupk[13]={0x49,0x07,0,0,0,0,0x04,0,0,0,0,0,0};

    mcupk[2] =wAddr;
    mcupk[3] =wAddr>>8;
    mcupk[4] =wAddr>>16;
    mcupk[5] =wAddr>>24;
    mcupk[8] =wSize;
    mcupk[9] =wSize>>8;
    mcupk[10]=wSize>>16;
    mcupk[11]=wSize>>24;

    mcupk[12]=get_mcu_sum_check(mcupk,12);
    app_uart_transmit_sync(APP_UART_ID_1,mcupk,13,100);
    mcupk[0]=0;
    app_uart_receive_sync(APP_UART_ID_1,mcupk,10,100);
    checksum=get_mcu_sum_check(mcupk,9);
    if(mcupk[0]!=0x49 || mcupk[9]!=checksum || mcupk[8]!=MCU_ACK_SUCEESS)
    {
        LOG("mcu Ack:%x\r\n",mcupk[0]);
        return MCU_FLASH_CHECK_BLANK_FAIL;
    }
    return MCU_STATUS_OK;
}



/**
 *****************************************************************************************
 * @brief 
 *
 * @param[in]
 *
 * @return 
 *****************************************************************************************
 */
uint16_t mcu_flash_programming(uint32_t firmwareStartAddr)//编程
{
    uint8_t checksum;
    uint8_t mcupk[SEND_PACKAGE_SIZE+9];
    uint16_t i;
    uint16_t offsetAddr;
    uint16_t ackAddr;


    firmwareCheckSum=0;
    for(i=0;i<(FIRMWARE_SIZE/SEND_PACKAGE_SIZE);i++)
    {
        mcupk[0]=0x49;
        mcupk[1]=4;

        offsetAddr=i*SEND_PACKAGE_SIZE;
        hal_flash_read(firmwareStartAddr+offsetAddr,&mcupk[8], SEND_PACKAGE_SIZE);

        firmwareCheckSum+=get_mcu_sum_check(&mcupk[8],SEND_PACKAGE_SIZE);

        mcupk[2] =offsetAddr;
        mcupk[3] =offsetAddr>>8;
        mcupk[4] =offsetAddr>>16;
        mcupk[5] =offsetAddr>>24;

        mcupk[6] =(uint8_t)SEND_PACKAGE_SIZE;
        mcupk[7] =SEND_PACKAGE_SIZE>>8; 

        mcupk[SEND_PACKAGE_SIZE+8]=get_mcu_sum_check(mcupk,SEND_PACKAGE_SIZE+8);
        app_uart_transmit_sync(APP_UART_ID_1,mcupk,SEND_PACKAGE_SIZE+9,100);
        mcupk[0]=0;
        app_uart_receive_sync(APP_UART_ID_1,mcupk,9,100);
        ackAddr=((mcupk[3]&0xFFFFFFFF)<<8)|mcupk[2];
        checksum=get_mcu_sum_check(mcupk,8);
        if(mcupk[0]!=0x49 || mcupk[8]!=checksum ||offsetAddr!=ackAddr)
        {
            LOG("mcu Ack:%x\r\n",mcupk[0]);
            return MCU_WRITE_FIRMWARE_FAIL;
        }
    }

    if(FIRMWARE_SIZE%SEND_PACKAGE_SIZE)  //非标准
    {
        memset(mcupk,0,sizeof(mcupk));

        mcupk[0]=0x49;
        mcupk[1]=4;

        offsetAddr=i*SEND_PACKAGE_SIZE;
        hal_flash_read(firmwareStartAddr+offsetAddr,&mcupk[8], FIRMWARE_SIZE%SEND_PACKAGE_SIZE);

        firmwareCheckSum+=get_mcu_sum_check(&mcupk[8],SEND_PACKAGE_SIZE);

        mcupk[2] =offsetAddr;
        mcupk[3] =offsetAddr>>8;
        mcupk[4] =offsetAddr>>16;
        mcupk[5] =offsetAddr>>24;

        mcupk[6] =(uint8_t)SEND_PACKAGE_SIZE;
        mcupk[7] =SEND_PACKAGE_SIZE>>8;

        mcupk[SEND_PACKAGE_SIZE+8]=get_mcu_sum_check(mcupk,SEND_PACKAGE_SIZE+8);
        app_uart_transmit_sync(APP_UART_ID_1,mcupk,SEND_PACKAGE_SIZE+9,100);
        mcupk[0]=0;
        app_uart_receive_sync(APP_UART_ID_1,mcupk,9,100);
        ackAddr=((mcupk[3]&0xFFFFFFFF)<<8)|mcupk[2];
        checksum=get_mcu_sum_check(mcupk,8);
        if(mcupk[0]!=0x49 || mcupk[8]!=checksum ||offsetAddr!=ackAddr)
        {
            LOG("mcu Ack:%x\r\n",mcupk[0]);
            return MCU_WRITE_FIRMWARE_FAIL;
        }
    }
    return MCU_STATUS_OK;
}


/**
 *****************************************************************************************
 * @brief 
 *
 * @param[in]
 *
 * @return 
 *****************************************************************************************
 */
uint16_t mcu_get_firmware_checksum(uint32_t checksize)
{
    uint8_t checksum;
    uint8_t mcupk[13]={0x49,6,0,0,0,0,4,0,0,0,0,0,0};
    uint16_t fmchecksum;

    mcupk[8] =checksize;
    mcupk[9] =checksize>>8;
    mcupk[10]=checksize>>16;
    mcupk[11]=checksize>>24;
    mcupk[12]=get_mcu_sum_check(mcupk,12);

    app_uart_transmit_sync(APP_UART_ID_1,mcupk,13,100);
    mcupk[0]=0;
    app_uart_receive_sync(APP_UART_ID_1,mcupk,11,100);
    checksum=get_mcu_sum_check(mcupk,10);
    if(mcupk[0]!=0x49 || mcupk[10]!=checksum)
    {
        LOG("mcu Ack:%x\r\n",mcupk[0]);
        return MCU_GET_FIRMWARE_ECC_FAIL;
    }
    fmchecksum=((mcupk[9]&0XFFFF)<<8)|mcupk[8];

    if(fmchecksum!=firmwareCheckSum)
    {
        LOG("fm check sum:%4x,%4x\r\n",fmchecksum,firmwareCheckSum);
        return MCU_FIRMWARE_ECC_VERIFY_FAIL;
    }
    return MCU_STATUS_OK;
}




/**
 *****************************************************************************************
 * @brief 
 *
 * @param[in]
 *
 * @return 
 *****************************************************************************************
 */
uint16_t mcu_flash_encryption(void)//加密
{
    uint8_t mcupk[9]={0x49,9,0,0,0,0,0,0,0};


    mcupk[8]=get_mcu_sum_check(mcupk,8);

    app_uart_transmit_sync(APP_UART_ID_1,mcupk,9,100);
    mcupk[0]=0;
    app_uart_receive_sync(APP_UART_ID_1,mcupk,9,100);
    if(mcupk[0]!=0x49 || mcupk[8]!=0x49)
    {
        LOG("mcu Ack:%x\r\n",mcupk[0]);
        return MCU_FIRMWARE_ENCRYPTION_FAIL;
    }
    return MCU_STATUS_OK;
}




/**
 *****************************************************************************************
 * @brief 
 *
 * @param[in]
 *
 * @return 
 *****************************************************************************************
 */
uint16_t mcu_upgraded_reset(void)//复位
{
    uint8_t mcupk[9]={0x49,0x0A,0,0,0,0,0,0,0};

    mcupk[8]=get_mcu_sum_check(mcupk,8);
    app_uart_transmit_sync(APP_UART_ID_1,mcupk,9,100);
    mcupk[0]=0;
    app_uart_receive_sync(APP_UART_ID_1,mcupk,9,100);
    if(mcupk[0]!=0x49 || mcupk[8]!=0x49)
    {
        LOG("mcu Ack:%x\r\n",mcupk[0]);
        return MCU_UPGRADE_RESET_FAIL;
    }
    return MCU_STATUS_OK;
}



/**
 *****************************************************************************************
 * @brief 
 *
 * @param[in]
 *
 * @return 
 *****************************************************************************************
 */
uint16_t mcu_upgrade_handle(uint32_t firmwareStartAddr)
{
    ll_uart_set_baud_rate(UART1,CLK_64M,MCU_RAMBOOT_BAUDRATE);

    if(mcu_enter_romboot()!=MCU_STATUS_OK)
    {
        return ENTER_MCU_RAMCODE_MODE_FAIL;
    }

    maxeye_wdt_refresh();

    if(write_mcu_ramcode()!=MCU_STATUS_OK)
    {
        return WRITE_MCU_RAMCODE_FAIL;
    }

    if(mcu_ramcode_run()!=MCU_STATUS_OK)
    {
        return MCU_RAMCODE_RUN_FAIL;
    }

    if(mcu_uart_baudrate_set(MCU_UPGRADE_BAUDRATE)!=MCU_STATUS_OK)          // 49 01
    {
        return MCU_BAUDRATE_SET_FAIL;
    }

    if(mcu_flash_erase(FIRMWARE_SIZE)!=MCU_STATUS_OK)                       // 49 03
    {
        return MCU_ERASE_FLASH_FAIL;
    }

    if(mcu_flash_check_blank(0,FIRMWARE_SIZE)!=MCU_STATUS_OK)               // 49 07
    {
        return MCU_FLASH_CHECK_BLANK_FAIL;
    }

    maxeye_wdt_refresh();

    if(mcu_flash_programming(firmwareStartAddr)!=MCU_STATUS_OK)             // 49 04
    {
        return MCU_WRITE_FIRMWARE_FAIL;
    }

    if(mcu_get_firmware_checksum(FIRMWARE_SIZE)!=MCU_STATUS_OK)             // 49 06
    {
        return MCU_FIRMWARE_ECC_VERIFY_FAIL;
    }

    // if(mcu_flash_encryption()!=MCU_STATUS_OK)                            // 49 09
    // {
    //  return MCU_FIRMWARE_ENCRYPTION_FAIL;
    // }

    if(mcu_upgraded_reset()!=MCU_STATUS_OK)                                 // 49 0A
    {
        return MCU_UPGRADE_RESET_FAIL;
    }

    mcu_reset_control();

    return MCU_STATUS_OK;
}



